## components/pong/Kconfig
```kconfig
menu "Pong input source"

choice PONG_SOURCE
    prompt "Pong frame source"
    default PONG_SOURCE_RADIO
    help
        Where pong_rx_task reads demodulated Pong lines from.

    config PONG_SOURCE_RADIO
        bool "Real Pong radio (UART2 @ 3 Mbaud)"
        help
            Production: read the uAvionix Pong on UART2 (GPIO35 RX / GPIO33 TX)
            at 3,000,000 baud, static RTS on GPIO32. See AGENTS.md.

    config PONG_SOURCE_CONSOLE
        bool "Replay over console USB (UART0) — dev harness"
        help
            Development: read Pong-format lines from the console UART (UART0,
            the onboard USB-serial bridge) instead of the radio, so a host can
            inject a recorded capture with tools/pong_replay.py over the single
            USB cable. Firmware logs still go out on UART0 TX, which the replay
            tool reads back. The onboard bridge is unreliable above ~115200
            (AGENTS.md), so this path runs at PONG_CONSOLE_BAUD (default 115200),
            NOT 3 Mbaud — fine for the ~3 KB/s real-time stream.
endchoice

config PONG_CONSOLE_BAUD
    int "Pong console replay baud"
    depends on PONG_SOURCE_CONSOLE
    default 115200
    help
        Baud for the UART0 replay link. Keep at the console default (115200)
        unless the USB-serial bridge is proven reliable higher. Must match the
        --baud passed to tools/pong_replay.py.

endmenu
```

## sdkconfig.defaults
```kconfig
# Common defaults — shared by both radio configurations. Radio-specific
# settings live in sdkconfig.defaults.wifi / .bt and are layered on top via
# SDKCONFIG_DEFAULTS (see top-level CMakeLists.txt).

# Target chip — original ESP32 (TTGO T8, ESP32-D0WD-V3, silicon rev v3.1).
CONFIG_IDF_TARGET="esp32"

# Module ships with 4 MB flash; the default kconfig assumes 2 MB.
CONFIG_ESPTOOLPY_FLASHSIZE_4MB=y
CONFIG_ESPTOOLPY_FLASHSIZE="4MB"

# --- PSRAM (TTGO T8: 8 MB physical, only 4 MB heap-mappable on original ESP32;
# upper 4 MB is reachable only via the bank-switched himem API). Quad SPI,
# auto-detect size, malloc-backed.
CONFIG_SPIRAM=y
CONFIG_SPIRAM_MODE_QUAD=y
CONFIG_SPIRAM_TYPE_AUTO=y
CONFIG_SPIRAM_SPEED_40M=y
CONFIG_SPIRAM_BOOT_INIT=y
CONFIG_SPIRAM_USE_MALLOC=y
# Tolerate a non-PSRAM bring-up devkit: without this, SPIRAM_BOOT_INIT abort()s
# at boot when no PSRAM is found.
CONFIG_SPIRAM_IGNORE_NOTFOUND=y

# --- Partition table — custom layout to use the full 4 MB (partitions.csv) ---
CONFIG_PARTITION_TABLE_CUSTOM=y
CONFIG_PARTITION_TABLE_CUSTOM_FILENAME="partitions.csv"
CONFIG_PARTITION_TABLE_OFFSET=0x8000

# --- Tasks / stacks ---
# 8 KB main task stack for headroom (matches connext-emulator baseline).
CONFIG_ESP_MAIN_TASK_STACK_SIZE=8192

# --- Logging ---
# Log with ESP_LOGx directly; avoid deep custom logging callbacks on the main
# task (the lesson from connext's early-boot-loop debugging).
CONFIG_LOG_DEFAULT_LEVEL_INFO=y

# --- HTTP server ---
# WebSocket support for the web UI live feeds (WS /traffic, WS /status — §10/M2);
# enables the httpd_uri_t .is_websocket field used by components/web.
CONFIG_HTTPD_WS_SUPPORT=y
```

## sdkconfig.defaults.bt
```kconfig
# Radio configuration: Bluetooth Classic (Connext/BT-SPP) — RESERVED for M6.
# Layered on top of sdkconfig.defaults via `-D RADIO=bt`. Not implemented yet;
# this overlay only exists so the radio-selection wrapper in CMakeLists.txt has
# a valid `bt` target. The full overlay (BR/EDR-only, BLE off, SPP, custom SDP)
# will be ported from connext-emulator/esp32/sdkconfig.defaults.bt at M6.
# WiFi + BT Classic can't coexist on the original ESP32, so this is a separate
# build variant, not a runtime toggle.

# --- Bluetooth ON (controller + Bluedroid BR/EDR only) ---
CONFIG_BT_ENABLED=y
CONFIG_BT_CONTROLLER_ENABLED=y
CONFIG_BT_BLUEDROID_ENABLED=y
CONFIG_BT_CLASSIC_ENABLED=y
CONFIG_BT_SPP_ENABLED=y
CONFIG_BT_BLE_ENABLED=n
CONFIG_BTDM_CTRL_MODE_BR_EDR_ONLY=y
CONFIG_BTDM_CTRL_MODE_BLE_ONLY=n
CONFIG_BTDM_CTRL_MODE_BTDM=n
```

## sdkconfig.defaults.wifi
```kconfig
# Radio configuration: WiFi SoftAP — the primary GDL90-over-UDP output path.
# Layered on top of sdkconfig.defaults via `-D RADIO=wifi` (the default).

# --- Bluetooth OFF ---
# Frees the BT controller + Bluedroid DRAM. The original ESP32 cannot host
# both stacks at once; the Connext/BT variant is a separate binary (M6).
CONFIG_BT_ENABLED=n

# --- WiFi / lwIP ---
# WiFi and lwIP are enabled by default in ESP-IDF; the key tuning here is
# pushing their buffers into PSRAM to keep internal DRAM headroom comfortable
# for the traffic table and decoders.
CONFIG_ESP_WIFI_ENABLED=y
CONFIG_SPIRAM_TRY_ALLOCATE_WIFI_LWIP=y
```
